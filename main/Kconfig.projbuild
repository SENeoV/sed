## main/Kconfig.projbuild
```kconfig
# Custom config value
menu "WiFi Configuration"
config ESP_WIFI_SSID
    string "WiFi SSID"
    default "sed"
    help
	SSID (network name) for the esp32 to connect to.

config ESP_WIFI_PASSWORD
    string "WiFi Password"
    default "Qasw1234."
    help
	WiFi password (WPA or WPA2) for the esp32 to use.
endmenu
```
